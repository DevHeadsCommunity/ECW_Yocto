## layers/project/meta-ecw/meta-ecw-core/conf/distro/microforge.conf
```bitbake
DISTRO = "microforge"
DISTRO_NAME = "Microforge (ECW Reference Distro)"
DISTRO_VERSION = "1.0.0"
DISTRO_CODENAME = "ember"
SDK_VENDOR = "-ecwsdk"
SDK_VERSION = "${@d.getVar('DISTRO_VERSION').replace('snapshot-${METADATA_REVISION}', 'snapshot')}"
SDK_VERSION[vardepvalue] = "${SDK_VERSION}"

MAINTAINER = "Ming <ming@siliconbladeconsultants.com>"

TARGET_VENDOR = "-ecw"

LOCALCONF_VERSION = "2"

# Override these in poky based distros
MICROFORGE_DEFAULT_DISTRO_FEATURES = "usrmerge systemd systemd-resolved networkd "
MICROFORGE_DEFAULT_EXTRA_RDEPENDS = "packagegroup-core-boot"
MICROFORGE_DEFAULT_EXTRA_RRECOMMENDS = "kernel-module-af-packet"

DISTRO_FEATURES ?= "${DISTRO_FEATURES_DEFAULT} ${MICROFORGE_DEFAULT_DISTRO_FEATURES}"
DISTRO_FEATURES:remove = "x11"

SDK_NAME = "${DISTRO}-${TCLIBC}-${SDKMACHINE}-${IMAGE_BASENAME}-${TUNE_PKGARCH}-${MACHINE}"
SDKPATHINSTALL = "/opt/${DISTRO}/${SDK_VERSION}"

DISTRO_EXTRA_RDEPENDS += "${MICROFORGE_DEFAULT_EXTRA_RDEPENDS}"
DISTRO_EXTRA_RRECOMMENDS += "${MICROFORGE_DEFAULT_EXTRA_RRECOMMENDS}"

TCLIBCAPPEND = ""

PACKAGE_CLASSES ?= "package_ipk"
IMAGE_FSTYPES += "tar.bz2 ext4"

MICROFORGE_INIT_MANAGER = "systemd"
INIT_MANAGER = "${MICROFORGE_INIT_MANAGER}"

# Set up the intramfs
INITRAMFS_IMAGE ?= "ecw-image-minimal-initramfs"
INITRAMFS_IMAGE_BUNDLE ?= "0"
INITRAMFS_FSTYPES ?= "cpio.gz"
INITRAMFS_IMAGE_NAME ?= "${INITRAMFS_IMAGE}-${MACHINE}"

# Allow for machine specific options
include conf/distro/${DISTRO}/${MACHINE}/machine-distro-extras.inc

SANITY_TESTED_DISTROS ?= " \
            poky-4.3 \n \
            poky-5.0 \n \
            microforge-1.0 \n \
            ubuntu-20.04 \n \
            ubuntu-22.04 \n \
            ubuntu-23.04 \n \
            ubuntu-24.04 \n \
            fedora-38 \n \
            fedora-39 \n \
            fedora-40 \n \
            centosstream-8 \n \
            debian-11 \n \
            debian-12 \n \
            debian-13 \n \
            opensuseleap-15.4 \n \
            almalinux-8.8 \n \
            almalinux-8.9 \n \
            almalinux-8.10 \n \
            almalinux-9.2 \n \
            almalinux-9.4 \n \
            rocky-9 \n \
            "
# add poky sanity bbclass
INHERIT += "poky-sanity"

# QA check settings - a little stricter than the OE-Core defaults
# (none currently necessary as we now match OE-Core)
#WARN_TO_ERROR_QA = "X"
#WARN_QA_remove = "${WARN_TO_ERROR_QA}"
#ERROR_QA_append = " ${WARN_TO_ERROR_QA}"

require conf/distro/include/poky-world-exclude.inc
require conf/distro/include/no-static-libs.inc
require conf/distro/include/yocto-uninative.inc
require conf/distro/include/security_flags.inc
INHERIT += "uninative"

BB_SIGNATURE_HANDLER ?= "OEEquivHash"
BB_HASHSERVE ??= "auto"

# We need debug symbols so that SPDX license manifests for the kernel work
KERNEL_EXTRA_FEATURES:append = " features/debug/debug-kernel.scc"

# Enable creation of SPDX manifests by default
INHERIT += "create-spdx"
```

## layers/project/meta-ecw/meta-ecw-core/conf/layer.conf
```bitbake
# We have a conf and classes directory, add to BBPATH
BBPATH .= ":${LAYERDIR}"

# We have recipes-* directories, add to BBFILES
BBFILES += "${LAYERDIR}/recipes-*/*/*.bb \
            ${LAYERDIR}/recipes-*/*/*.bbappend"

BBFILE_COLLECTIONS += "meta-ecw-core"
BBFILE_PATTERN_meta-ecw-core = "^${LAYERDIR}/"
# Significantly increase the priority of our layers
BBFILE_PRIORITY_meta-ecw-core = "21"

LAYERDEPENDS_meta-ecw-core = "core"
LAYERSERIES_COMPAT_meta-ecw-core = "scarthgap"
```
